## 01_firmware_esp32/main/Kconfig.projbuild
```kconfig
menu "PSI3542 Aula 10"
config A10_WIFI_SSID
    string "Wi-Fi SSID"
    default ""
config A10_WIFI_PASSWORD
    string "Wi-Fi Password"
    default ""
config A10_AWS_IOT_ENDPOINT
    string "AWS IoT data endpoint (hostname only)"
    default ""
    help
        Example: abcdefghijklmn-ats.iot.sa-east-1.amazonaws.com
        Do not include mqtts:// or :8883. An empty endpoint disables the
        AWS IoT/MQTT path for that boot while local and HTTP functions remain.
config A10_THING_NAME
    string "AWS IoT Thing name / MQTT client_id"
    default "psi3542-g01"
    help
        Course convention: client_id = Thing name. Use 1 to 32 characters:
        A-Z, a-z, 0-9, '-' or '_'. Do not use '/', '+' or '#'.
config A10_SNTP_SERVER
    string "SNTP server"
    default "pool.ntp.org"
config A10_HTTP_PORT
    int "HTTP server port"
    range 80 65535
    default 80
config A10_DHT11_GPIO
    int "GPIO do DHT11"
    range 0 33
    default 4
config A10_DOOR_GPIO
    int "GPIO da chave/botao"
    range 0 33
    default 27
config A10_DOOR_DEBOUNCE_MS
    int "Janela de debounce da chave/botao (ms)"
    range 10 200
    default 50
    help
        Tempo de quietude exigido depois da ultima borda eletrica antes de
        event_task amostrar o nivel logico da chave.
config A10_LED_GPIO
    int "GPIO do LED local"
    range 0 33
    default 2
config A10_SENSOR_PERIOD_MS
    int "Periodo de aquisicao do DHT11 (ms)"
    range 2000 60000
    default 3000
config A10_FORCE_SENSOR_UNAVAILABLE_READS
    int "Extensao: forcar N aquisicoes iniciais como indisponiveis"
    range 0 100
    default 0
config A10_PUBLISH_QUEUE_LEN
    int "Publish queue length"
    range 2 32
    default 6
config A10_COMMAND_QUEUE_LEN
    int "Cloud command queue length"
    range 1 16
    default 4
config A10_HEALTH_ENABLED
    bool "Publicar health operacional no AWS IoT Core"
    default y
    help
        Publica periodicamente o estado operacional do proprio dispositivo
        em psi3542/<thingName>/health. Nao representa telemetria do ambiente.
config A10_HEALTH_PERIOD_MS
    int "Periodo do health report (ms)"
    range 5000 300000
    default 15000
config A10_HEALTH_QOS
    int "Health QoS"
    range 0 1
    default 0
config A10_TELEMETRY_QOS
    int "Telemetry QoS"
    range 0 1
    default 0
config A10_EVENT_QOS
    int "Event QoS"
    range 0 1
    default 1
config A10_COMMAND_QOS
    int "Command subscription QoS"
    range 0 1
    default 1
config A10_COMMAND_MAX_PAYLOAD
    int "Maximum cloud command payload (bytes)"
    range 32 512
    default 128
config A10_LOCAL_BASELINE_MS
    int "Baseline local antes de iniciar Wi-Fi (ms)"
    range 0 60000
    default 8000
endmenu

menu "Riego automatico con IA (edge computing)"

    menu "Pines / conexiones"
        comment "DHT11 (A10_DHT11_GPIO), LED y boton de puerta estan en el menu PSI3542 Aula 10"

        config A10_SOIL_ADC_GPIO
            int "Sensor de humedad de suelo - salida analogica AO (GPIO)"
            range 32 39
            default 34
            help
                Debe ser un pin ADC1 (GPIO32..39). ADC2 no se puede usar con Wi-Fi.
                GPIO34..39 son solo entrada (no tienen pull-up interno): correcto para AO.

        config A10_PUMP_RELAY_GPIO
            int "Rele de la bomba - pin IN (GPIO)"
            range 0 33
            default 26

        config A10_PUMP_RELAY_ACTIVE_LOW
            bool "Rele activo en nivel bajo (modulos de 1 canal tipicos)"
            default y
            help
                y: IN=0 activa el rele. n: IN=1 activa el rele.

        config A10_BUZZER_GPIO
            int "Buzzer activo (GPIO)"
            range 0 33
            default 25

        config A10_BUZZER_ACTIVE_LOW
            bool "Buzzer activo en nivel bajo"
            default n

        config A10_LCD_I2C_SDA_GPIO
            int "LCD I2C - SDA (GPIO)"
            range 0 33
            default 21

        config A10_LCD_I2C_SCL_GPIO
            int "LCD I2C - SCL (GPIO)"
            range 0 33
            default 22

        config A10_LCD_I2C_ADDR
            hex "LCD I2C - direccion de 7 bits"
            range 0x08 0x77
            default 0x27
            help
                0x27 (PCF8574) o 0x3F (PCF8574A). Si el LCD no responde, el log
                muestra "nenhum dispositivo I2C" y el resto del firmware sigue.

        config A10_LCD_I2C_FREQ_HZ
            int "LCD I2C - frecuencia (Hz)"
            range 10000 400000
            default 100000

        config A10_LCD_BACKLIGHT
            bool "LCD con luz de fondo encendida"
            default y

        config A10_UI_BUTTON_GPIO
            int "Boton de pagina del LCD (GPIO, entre pin y GND)"
            range 0 33
            default 33
            help
                Usa pull-up interno; el boton conecta el pin a GND.
    endmenu

    menu "Sensor de humedad de suelo"
        config A10_SOIL_RAW_DRY
            int "Lectura ADC en seco (0 %)"
            range 0 4095
            default 3200
            help
                Valor crudo (12 bits) con el sensor en el aire. Calibre mirando el
                log "[LOCAL][SOIL] raw=...". Para sensor capacitivo suele ser 2800..3500.

        config A10_SOIL_RAW_WET
            int "Lectura ADC en agua (100 %)"
            range 0 4095
            default 1400
            help
                Valor crudo (12 bits) con el sensor sumergido hasta la linea marcada.
                Debe ser distinto de A10_SOIL_RAW_DRY (menor para sensor capacitivo).

        config A10_SOIL_SAMPLES
            int "Muestras ADC promediadas por lectura"
            range 1 64
            default 16
    endmenu

    menu "Riego"
        config A10_IRRIGATION_ENABLED
            bool "Habilitar riego automatico (IA)"
            default y
            help
                Si esta en n, el firmware solo mide y muestra datos; la bomba
                nunca se activa.

        config A10_PLANT_ID
            int "Planta (localname del modelo, 1..8)"
            range 1 8
            default 1
            help
                Es el id de planta usado al entrenar el modelo (columna localname
                del dataset). El modelo actual conoce los ids 1 a 8.

        config A10_IRRIGATION_CHECK_PERIOD_MS
            int "Periodo de decision de la IA (ms)"
            range 1000 600000
            default 10000

        config A10_IRRIGATION_COOLDOWN_S
            int "Tiempo minimo entre dos riegos (s)"
            range 0 86400
            default 600
            help
                El suelo tarda en absorber el agua; evita regar de nuevo antes de
                que el sensor refleje el cambio.

        config A10_IRRIGATION_MIN_ML
            int "Volumen minimo para encender la bomba (ml)"
            range 1 1000
            default 10

        config A10_IRRIGATION_SOIL_MAX_PCT
            int "Humedad de suelo maxima para regar (%)"
            range 1 100
            default 60
            help
                Seguridad: si el suelo esta mas humedo que esto, no se riega aunque
                el modelo lo pida.

        config A10_PUMP_FLOW_ML_PER_MIN
            int "Caudal de la bomba (ml/min)"
            range 10 20000
            default 1200
            help
                Mida cuantos ml entrega la bomba en 1 minuto con su manguera real.
                Tiempo de bomba = ml_recomendados / caudal.

        config A10_PUMP_MAX_ON_MS
            int "Tiempo maximo de bomba encendida por riego (ms)"
            range 500 300000
            default 30000

        config A10_PUMP_BEEP_COUNT
            int "Bips del buzzer al encender la bomba (0 = silencio)"
            range 0 10
            default 2
    endmenu

    menu "Pantalla"
        config A10_LCD_ENABLED
            bool "Habilitar LCD 16x2 I2C y boton de paginas"
            default y

        config A10_UI_REFRESH_MS
            int "Refresco del LCD (ms)"
            range 100 5000
            default 500

        config A10_UI_BUTTON_DEBOUNCE_MS
            int "Debounce del boton de paginas (ms)"
            range 20 500
            default 60
    endmenu
endmenu
```
